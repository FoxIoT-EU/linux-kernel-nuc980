## arch/arm/mach-nuc980/Kconfig
```kconfig
# SPDX-License-Identifier: GPL-2.0-only
menuconfig ARCH_NUC980
	bool "Nuvoton NUC980 Architecture"

if ARCH_NUC980

config CPU_NUC980
	bool
	depends on ARCH_MULTI_V5
	select CPU_ARM926T
	select CLKDEV_LOOKUP
	select COMMON_CLK
	select GENERIC_CLOCKEVENTS
	select GENERIC_IRQ_CHIP
	select GPIOLIB
	select IRQ_DOMAIN
	select MULTI_IRQ_HANDLER
	select NUC980_TIMER
	select PINCTRL
	select SPARSE_IRQ
	help
	  Support of Nuvoton NUC980 MPU

endif
```

## drivers/net/ethernet/nuvoton/Kconfig
```kconfig
# SPDX-License-Identifier: GPL-2.0-only
#
# Nuvoton network device configuration
#

config NET_VENDOR_NUVOTON
	bool "Nuvoton devices"
	default y
	depends on ARM && ARCH_NUC980
	help
	  If you have a network (Ethernet) card belonging to this class, say Y.

	  Note that the answer to this question doesn't directly affect the
	  kernel: saying N will just cause the configurator to skip all
	  the questions about Nuvoton cards. If you say Y, you will be asked
	  for your specific card in the following questions.

if NET_VENDOR_NUVOTON

config NUC980_EMAC
	bool "Nuvoton NUC980 Ethernet support"
	depends on ARM && ARCH_NUC980
	select PHYLIB
	select MII
	help
	  Say Y here if you want to use built-in Ethernet ports
	  on NUC980 processor.

endif # NET_VENDOR_NUVOTON
```

## sound/soc/nuvoton/Kconfig
```kconfig
config SND_SOC_NUC980_I2S
	tristate "SoC Audio (I2S protocol) for NUC980 SoC"
	depends on ARCH_NUC980 && SND_SOC
	help
	  This option enables support for I2S on the NUC980 SoC.
```
